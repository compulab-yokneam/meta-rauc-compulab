## conf/layer.conf
```bitbake
# We have a conf and classes directory, add to BBPATH
BBPATH .= ":${LAYERDIR}"

# We have recipes-* directories, add to BBFILES
BBFILES += "${LAYERDIR}/recipes-*/*/*.bb \
            ${LAYERDIR}/recipes-*/*/*.bbappend"

BBFILE_COLLECTIONS += "meta-rauc-compulab"
BBFILE_PATTERN_meta-rauc-compulab = "^${LAYERDIR}/"
BBFILE_PRIORITY_meta-rauc-compulab = "6"

LAYERDEPENDS_meta-rauc-compulab = "core rauc freescale-layer freescale-3rdparty"
LAYERSERIES_COMPAT_meta-rauc-compulab = "scarthgap"

# Configurations add-ons
IMAGE_INSTALL:append = " rauc"
DISTRO_FEATURES:append = " rauc"
# ext4 image format required
IMAGE_FSTYPES:append = " ext4"

# Append the u-boot script to boot files::

IMAGE_BOOT_FILES:append = " boot.scr"

# Select the Kickstart file::

WKS_FILE = "sdimage-dual-compulab.wks.in"
WKS_FILES:prepend = "sdimage-dual-compulab.wks.in "

# Add 150 000 Kbytes free space to rootfs
IMAGE_ROOTFS_EXTRA_SPACE:append = " + 150000"
```
